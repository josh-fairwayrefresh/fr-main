## CMakeLists.txt
```
# SPDX-License-Identifier: Apache-2.0

cmake_minimum_required(VERSION 3.21)

find_package(Zephyr HINTS $ENV{ZEPHYR_BASE})
project(blinky)

if(CONFIG_BOARD_CIRCUITDOJO_FEATHER_NRF9151)
    if(CONFIG_FAIRWAY_USB_COMMISSIONING)
        target_sources(app PRIVATE src/usb_commissioning.c src/device_identity.c src/power_policy.c)
    else()
        target_sources(app PRIVATE src/main.c
        src/command_protocol.c src/demand_window.c src/complete_poll.c
        src/golfer_txn.c src/power_policy.c src/http_transport.c
        src/golfer_protocol.c src/button_ux.c src/modem_service.c
        src/transaction_scheduler.c src/device_identity.c)
        if(CONFIG_FAIRWAY_OTA)
            target_sources(app PRIVATE src/ota_update.c src/ota_update_policy.c
                src/ota_update_staging.c src/ota_update_scheduler.c
                src/ota_update_discovery.c src/ota_update_download.c
                src/ota_update_reporting.c src/ota_delivery_reporting.c
                src/ota_delivery.c)
        endif()
    endif()
else()
    message(FATAL_ERROR "Fairway requires circuitdojo_feather_nrf9151")
endif()
```

## Kconfig
```
source "Kconfig.zephyr"

menu "Fairway firmware"

config FAIRWAY_USB_COMMISSIONING
	bool "Build the USB-only commissioning application instead of the operational runtime"
	depends on UART_INTERRUPT_DRIVEN
	default n
	help
	  Keeps the onboard debugger powered, receives buffered commissioning
	  transactions, and writes identity only through TF-M Protected Storage.
	  Never starts LTE, golfer transactions, or OTA scheduling.

config FAIRWAY_OTA
	bool "Enable MCUboot OTA staging and trial lifecycle"
	depends on DFU_TARGET_MCUBOOT
	default y
	help
	  Enables the transport-independent update staging API and MCUboot
	  test-boot confirmation lifecycle. It does not start network activity.

if FAIRWAY_OTA

config FAIRWAY_OTA_HARDWARE_ID
	string "Signed update target hardware identifier"
	default "circuitdojo_feather_nrf9151@1/nrf9151/ns"

config FAIRWAY_OTA_TRIAL_TIMEOUT_SECONDS
	int "Maximum time to confirm a trial image"
	range 30 600
	default 300
	help
	  Bounds normal-mode trial health evaluation. The Nordic modem library
	  documents that initialization can take a few minutes when modem
	  firmware update work is already scheduled. LTE registration and
	  backend availability are not part of this deadline. Service mode
	  does not arm the deadline.

config FAIRWAY_OTA_FIRMWARE_VERSION
	string "Firmware semantic version reported by this image"
	default "0.1.0+1"

config FAIRWAY_OTA_INITIAL_CHECK_DELAY_SECONDS
	int "Delay before the first one-time firmware check"
	range 60 86400
	default 900

choice FAIRWAY_OTA_SCHEDULE
	prompt "Firmware check schedule"
	default FAIRWAY_OTA_SCHEDULE_ONE_TIME

config FAIRWAY_OTA_SCHEDULE_ONE_TIME
	bool "One-time initial check"

config FAIRWAY_OTA_SCHEDULE_NIGHTLY
	bool "Nightly course-local check"

endchoice

endif

endmenu
```

## prj.conf
```kconfig
# Shared Fairway power-sandbox product configuration.
# This file holds the common behavior used by both Profile A and Profile B.
# Profile-specific logging/console settings live in prj_a.conf and prj_b.conf.
CONFIG_GPIO=y
CONFIG_LED=y
CONFIG_LED_NPM13XX=y
CONFIG_SENSOR=y
CONFIG_NPM13XX_CHARGER=y
CONFIG_REGULATOR=y
CONFIG_REGULATOR_NPM13XX=y

CONFIG_NRF_MODEM_LIB=y
CONFIG_NRF_MODEM_LIB_TRACE=n

CONFIG_LTE_LINK_CONTROL=y
CONFIG_LTE_LC_PSM_MODULE=y
CONFIG_LTE_EDRX_REQ=n
CONFIG_LTE_NETWORK_MODE_LTE_M=y
CONFIG_PDN=y

CONFIG_NETWORKING=y
CONFIG_NET_NATIVE=n
CONFIG_NET_SOCKETS=y
CONFIG_NET_SOCKETS_OFFLOAD=y
CONFIG_NET_IPV4=y
CONFIG_NET_IPV6=n
CONFIG_DNS_RESOLVER=y

CONFIG_MODEM_KEY_MGMT=y

CONFIG_JSON_LIBRARY=y
CONFIG_DATE_TIME=y
CONFIG_DOWNLOADER=y
CONFIG_DOWNLOADER_STACK_SIZE=1536

CONFIG_DFU_TARGET=y
CONFIG_DFU_TARGET_MCUBOOT=y
CONFIG_FLASH=y
CONFIG_FLASH_MAP=y
CONFIG_STREAM_FLASH=y
CONFIG_IMG_MANAGER=y
CONFIG_REBOOT=y
CONFIG_MBEDTLS_MAC_SHA256_ENABLED=y
CONFIG_FAIRWAY_OTA=y
CONFIG_FAIRWAY_OTA_FIRMWARE_VERSION="0.1.0+1"
CONFIG_MCUBOOT_IMGTOOL_SIGN_VERSION="0.1.0+1"

# Protected Storage uses the configurable TF-M profile and a hardware-unique
# key for encrypted, rollback-protected device state.
CONFIG_TFM_PROFILE_TYPE_NOT_SET=y
CONFIG_TFM_PARTITION_INTERNAL_TRUSTED_STORAGE=y
CONFIG_TFM_PARTITION_PLATFORM=y
CONFIG_TFM_PARTITION_CRYPTO=y
CONFIG_TFM_PARTITION_PROTECTED_STORAGE=y
CONFIG_TFM_PS_ROLLBACK_PROTECTION=y
CONFIG_PM_PARTITION_SIZE_TFM=0x1fe00
CONFIG_PM_PARTITION_SIZE_TFM_PROTECTED_STORAGE=0x8000
CONFIG_PM_PARTITION_SIZE_TFM_INTERNAL_TRUSTED_STORAGE=0x8000
CONFIG_PM_PARTITION_SIZE_TFM_OTP_NV_COUNTERS=0x8000
```

## prj_a.conf
```kconfig
# Profile A: instrumented validation build.
# Keep the normal debug output path so LTE registration, PSM requests, and wake behavior are observable.
CONFIG_LOG=y
CONFIG_LOG_PRINTK=y
CONFIG_CONSOLE=y
CONFIG_UART_CONSOLE=y
CONFIG_LOG_BACKEND_UART=y
CONFIG_LOG_PROCESS_TRIGGER_THRESHOLD=1
CONFIG_PM_DEVICE=y
CONFIG_PM_DEVICE_RUNTIME=y

# Keep AT monitor enabled for validation builds because it is an optional modem-notification
# utility and is not required for the product logic itself, but it is useful for observing LTE
# notification behavior during instrumentation-driven validation.
CONFIG_AT_MONITOR=y
```

## src/main.c
```c
/*
 * Fairway Refresh button-request orchestrator.
 *
 * This file wires together focused modules (see each header for its
 * owned concern) and contains only the golfer button/LED sequencing
 * itself:
 *   power_policy        - BUCK2 service rail and bounded interaction-awake keeper
 *   modem_service        - modem/cert/LTE bring-up, registration-triggered
 *                           DNS prewarm, and LTE PSM ownership
 *   http_transport        - DNS cache/resolver + bounded HTTPS primitive
 *   golfer_txn            - the accepted-transaction handoff/completion state
 *   golfer_protocol       - the golfer button_press wire protocol + retries
 *   button_ux             - button GPIO/ISR + three indicator LEDs
 *   transaction_scheduler - sole owner of the shared transport for golfer
 *                           and COMPLETE, auto-started
 *   complete_poll/demand_window/command_protocol - unchanged, pre-existing
 *
 * Approved Monarch Bay Pilot golfer UX (see docs/UX_SPECIFICATION.md,
 * "Final Monarch Bay Pilot Golfer UX"):
 *   Startup:
 *     Orange flashes 3 times
 *
 *   IDLE:
 *     All three indicators off
 *
 *   Valid press, no active demand window:
 *     Orange begins immediately and pulses for the unresolved transaction
 *     SUCCESS: orange off; green blink-blink then ~5 s solid; starts a local
 *       5-minute demand window from the original accepted press time
 *     FAILURE: orange off; red blink-blink then ~5 s solid; no demand window
 *     Return to IDLE
 *
 *   Valid press during an active 5-minute demand window:
 *     No orange, no new transaction, no new request; immediate green
 *     blink-blink then ~5 s solid; increments a local repeat-press counter
 *     on the originating transaction (preparatory state only; backend
 *     transport/persistence is a later work package, not implemented here)
 */

#include <zephyr/device.h>
#include <zephyr/kernel.h>
#include <zephyr/logging/log.h>
#include <zephyr/pm/device_runtime.h>

#include <errno.h>
#include <string.h>

#include "button_ux.h"
#include "command_protocol.h"
#include "complete_poll.h"
#include "device_identity.h"
#include "demand_window.h"
#include "golfer_txn.h"
#include "modem_service.h"
#include "power_policy.h"
#include "sync_primitives.h"
#include "thread_priorities.h"
#include "transaction_scheduler.h"
#if defined(CONFIG_FAIRWAY_OTA)
#include "ota_update.h"
#include "ota_delivery.h"
#endif

LOG_MODULE_REGISTER(main);

static const struct device *uart0_dev = DEVICE_DT_GET(DT_CHOSEN(zephyr_console));

#define GOLFER_TRANSACTION_BUDGET_MS      15000
#define BUTTON_REARM_SETTLE_MS            250

/* Continuous orange pulse cadence while a golfer transaction is unresolved;
 * reuses the previously validated initial-acknowledgement flash timing.
 */
#define ORANGE_PULSE_ON_MS       80
#define ORANGE_PULSE_OFF_MS      85

/* Canonical Monarch Bay Pilot golfer demand window (docs/UX_SPECIFICATION.md,
 * "Five-Minute Golfer Demand Window"), mirroring the backend's DEMAND_WINDOW_MS
 * (fairway_backend/cloudrun_receiver/lib/fleet/schema.js). Firmware-local
 * only; no shared code with the backend.
 */
#define DEMAND_WINDOW_MS         (5 * 60 * 1000)

/* Non-static: shared via sync_primitives.h with button_ux's ISR and the
 * transaction scheduler. See that header for why these two (and only
 * these two) are raw externs rather than function-wrapped.
 */
K_SEM_DEFINE(button_wake_sem, 0, 1);
K_SEM_DEFINE(txn_wake_sem, 0, 1);

BUILD_ASSERT(CONFIG_MAIN_THREAD_PRIORITY < TRANSACTION_THREAD_PRIORITY,
	     "button thread must always outrank the transaction scheduler");
BUILD_ASSERT(TRANSACTION_THREAD_PRIORITY < MODEM_SERVICE_THREAD_PRIORITY,
	     "transaction scheduler must always outrank background maintenance");
BUILD_ASSERT(MODEM_SERVICE_THREAD_PRIORITY < DNS_RESOLVER_THREAD_PRIORITY,
	     "background maintenance must always outrank isolated helpers");

typedef enum {
	STATE_IDLE = 0,
	STATE_BUTTON_ACK,
	STATE_TRANSMITTING,
	STATE_SUCCESS,
	STATE_FAILURE,
	STATE_REPEAT_PRESS,
} app_state_t;

static app_state_t state = STATE_IDLE;

static void set_state(app_state_t new_state)
{
	state = new_state;

	switch (state) {
	case STATE_IDLE:
		LOG_INF("STATE_IDLE");
		break;
	case STATE_BUTTON_ACK:
		LOG_INF("STATE_BUTTON_ACK");
		break;
	case STATE_TRANSMITTING:
		LOG_INF("STATE_TRANSMITTING");
		break;
	case STATE_SUCCESS:
		LOG_INF("STATE_SUCCESS");
		break;
	case STATE_FAILURE:
		LOG_INF("STATE_FAILURE");
		break;
	case STATE_REPEAT_PRESS:
		LOG_INF("STATE_REPEAT_PRESS");
		break;
	default:
		LOG_WRN("Unknown state: %d", state);
		break;
	}
}

int main(void)
{
	int ret;
#if defined(CONFIG_FAIRWAY_OTA)
	bool boot_health_evaluated = false;
	bool ota_init_ready = true;
	int64_t boot_started_uptime_ms = k_uptime_get();
#endif

	ret = button_ux_init(&button_wake_sem);
	if (ret < 0) {
		LOG_ERR("Button/indicator initialization failed: %d", ret);
#if defined(CONFIG_FAIRWAY_OTA)
		/* Service mode cannot be identified; keep a trial bounded so
		 * MCUboot can return to the previously confirmed image.
		 */
		ret = ota_update_init(false);
		if (ret < 0) {
			LOG_ERR("OTA lifecycle initialization failed: %d", ret);
		}
#endif
		return 0;
	}

	bool service_mode = false;
	ret = button_ux_is_pressed(&service_mode);
	if (ret < 0) {
		LOG_ERR("Boot button state read failed: %d", ret);
#if defined(CONFIG_FAIRWAY_OTA)
		ret = ota_update_init(false);
		if (ret < 0) {
			LOG_ERR("OTA lifecycle initialization failed: %d", ret);
		}
#endif
		return 0;
	}

#if defined(CONFIG_FAIRWAY_OTA)
	ret = ota_update_init(service_mode);
	if (ret < 0) {
		ota_init_ready = false;
		LOG_ERR("OTA lifecycle initialization failed: %d", ret);
	}
#endif

	ret = power_policy_init(service_mode);
	if (ret < 0) {
		LOG_ERR("Power policy initialization failed: %d", ret);
#if defined(CONFIG_FAIRWAY_OTA)
		if (service_mode) {
			ota_update_request_trial_revert(ret);
		}
#endif
		return 0;
	}

	if (service_mode) {
		button_ux_set_interrupt_enabled(false);
		button_ux_all_off();
		struct fairway_device_identity identity;
		ret = fairway_device_identity_load(&identity);
		if (ret == -ENOENT) {
			LOG_ERR("Device identity is not provisioned; install the USB commissioning image");
			return 0;
		}
		if (ret != 0) {
			LOG_ERR("Protected device identity could not be loaded: %d", ret);
			return 0;
		}
		memset(&identity, 0, sizeof(identity));
		LOG_INF("Debugger service mode: boot button held; LTE and golfer runtime are disabled");
		while (1) {
			k_sleep(K_FOREVER);
		}
	}

	struct fairway_device_identity identity;
	ret = fairway_device_identity_load(&identity);
	if (ret != 0) {
		LOG_ERR("Protected device identity is unavailable: %d", ret);
		return 0;
	}
	memset(&identity, 0, sizeof(identity));

#if defined(CONFIG_FAIRWAY_OTA)
	ret = fairway_ota_delivery_init(boot_started_uptime_ms);
	if (ret != 0) {
		LOG_ERR("OTA delivery worker initialization failed: %d", ret);
	}
#endif

	demand_window_init();
	complete_poll_init(&txn_wake_sem);

	if (!device_is_ready(uart0_dev)) {
		LOG_ERR("UART console device is not ready");
		return 0;
	}

	ret = pm_device_runtime_enable(uart0_dev);
	if (ret < 0) {
		LOG_ERR("UART runtime PM initialization failed: %d", ret);
		return 0;
	}

	/* Local hardware first: button/LED GPIO, callback, and interrupt are
	 * configured and armed, and this thread reaches its event loop,
	 * before any modem/network call is made -- the golfer button is live
	 * regardless of what modem_service does next or how long it takes.
	 */
	LOG_INF("Fairway Refresh state-machine feedback test starting");

	button_ux_startup_flash();

	set_state(STATE_IDLE);

	/* Releases modem_service to begin local modem bootstrap and the
	 * asynchronous LTE connection. Its terminal local result wakes this
	 * loop; this thread never blocks on modem initialization or registration.
	 */
	modem_service_notify_local_hw_ready(&button_wake_sem);
#if defined(CONFIG_FAIRWAY_OTA)
	fairway_ota_delivery_report_boot();
#endif

	LOG_INF("Ready. Waiting in low-power idle for button wake.");

	while (1) {
#if defined(CONFIG_FAIRWAY_OTA)
		if (!boot_health_evaluated) {
			int modem_bootstrap_result;
			int bootstrap_ret =
				modem_service_local_bootstrap_result(&modem_bootstrap_result);

			if (bootstrap_ret == 0) {
				boot_health_evaluated = true;
				if (modem_bootstrap_result != 0) {
					LOG_ERR("Mandatory modem bootstrap failed: %d; "
						"trial remains unconfirmed",
						modem_bootstrap_result);
				} else {
					ret = ota_update_confirm_healthy(ota_init_ready, true);
					if (ret < 0) {
						LOG_ERR("Boot-health confirmation failed: %d; "
							"trial remains unconfirmed",
							ret);
					} else {
						fairway_ota_delivery_report_healthy();
					}
				}
			} else if (bootstrap_ret != -EAGAIN) {
				boot_health_evaluated = true;
				LOG_ERR("Modem bootstrap result unavailable: %d; "
					"trial remains unconfirmed",
					bootstrap_ret);
			}
		}
#endif

		k_sem_take(&button_wake_sem, K_FOREVER);

		if (!button_ux_take_press_pending()) {
			continue;
		}

		LOG_INF("BUTTON_WAKE detected");
		power_policy_set_interaction_awake(true);

		int64_t press_time_ms = k_uptime_get();

		/* Active five-minute golfer demand window (docs/UX_SPECIFICATION.md,
		 * "Five-Minute Golfer Demand Window"): a valid press before the
		 * window's expiry is a same-group repeat, not a new golfer demand
		 * event. It never touches golfer_txn/txn_wake_sem -- no new
		 * transaction, no new request -- and is purely a local indicator
		 * echo plus a local counter increment. Naturally becomes false
		 * once press_time_ms reaches expires_at_ms, regardless of the
		 * stale `active` flag left over from the originating success.
		 */
		uint32_t repeat_press_count;
		if (demand_window_repeat_press(press_time_ms, &repeat_press_count)) {
			LOG_INF("REPEAT_PRESS within demand window: count=%u",
				repeat_press_count);

			button_ux_set_interrupt_enabled(false);

			set_state(STATE_REPEAT_PRESS);
			button_ux_show_success_feedback();

			k_sleep(K_MSEC(BUTTON_REARM_SETTLE_MS));
			button_ux_set_interrupt_enabled(true);
			power_policy_set_interaction_awake(false);
			set_state(STATE_IDLE);
			continue;
		}

		/* Keep switch bounce from queuing a second press during the
		 * active transaction; re-armed only after terminal feedback
		 * plus BUTTON_REARM_SETTLE_MS below.
		 */
		button_ux_set_interrupt_enabled(false);

		/* The hard 15-second deadline begins at acceptance, before the
		 * acknowledgement animation runs.
		 */
		int64_t accept_time_ms = press_time_ms;
		int64_t deadline_ms = accept_time_ms + GOLFER_TRANSACTION_BUDGET_MS;
		uint32_t my_gen = golfer_txn_accept(deadline_ms);

		set_state(STATE_TRANSMITTING);

		/* Canonical local acknowledgement begins here (orange physically
		 * turns on) -- strictly before the scheduler is released, so
		 * network/transaction work can never start ahead of the golfer's
		 * visible acknowledgement. The 15-second deadline above is
		 * unaffected: it was already fixed at acceptance, not here.
		 */
		button_ux_orange_on();
		k_sem_give(&txn_wake_sem);

		bool got_result = false;
		bool success = false;
		bool orange_lit = true;
		char request_id[FAIRWAY_REQUEST_ID_MAX];

		/* Orange pulses continuously for the whole unresolved transaction
		 * (docs/UX_SPECIFICATION.md: "pulses while the transaction is
		 * unresolved"), reusing the previously validated brief-flash
		 * cadence. Waiting is chunked to one pulse half-cycle at a time
		 * instead of the full remaining budget so the indicator can keep
		 * toggling; golfer_txn_check_done() is still checked on every
		 * wake (whether from a genuine completion signal or a pulse-phase
		 * timeout), so a real completion is still reacted to immediately,
		 * exactly as before this change. Only reaching the outer
		 * 15-second deadline itself (not a pulse-phase timeout) produces
		 * the defensive FAILURE fallback.
		 */
		while (1) {
			int64_t remaining_ms = deadline_ms - k_uptime_get();

			if (remaining_ms <= 0) {
				break;
			}

			int64_t phase_ms = orange_lit ? ORANGE_PULSE_ON_MS : ORANGE_PULSE_OFF_MS;
			int64_t wait_ms = (remaining_ms < phase_ms) ? remaining_ms : phase_ms;

			if (k_sem_take(&button_wake_sem, K_MSEC(wait_ms)) == 0) {
				if (golfer_txn_check_done(my_gen, &success, request_id,
							 sizeof(request_id))) {
					got_result = true;
					break;
				}
				/* Spurious wake (e.g. a completion signal for an
				 * already-expired generation): keep pulsing within
				 * the same bounded deadline.
				 */
				continue;
			}

			/* This pulse phase elapsed with no completion yet. */
			orange_lit = !orange_lit;
			if (orange_lit) {
				button_ux_orange_on();
			} else {
				button_ux_orange_off();
			}
		}

		button_ux_orange_off();

		if (got_result && success) {
			int64_t demand_deadline_ms = accept_time_ms + DEMAND_WINDOW_MS;

			demand_window_start(my_gen, request_id, demand_deadline_ms);
			complete_poll_start(my_gen, request_id, accept_time_ms,
					    demand_deadline_ms);
			set_state(STATE_SUCCESS);
			button_ux_show_success_feedback();
		} else {
			/* Local defensive deadline: guarantees a terminal
			 * disposition even in the unforeseen case that the
			 * transaction scheduler itself does not report back in
			 * time. Failure never establishes a demand window.
			 */
			set_state(STATE_FAILURE);
			button_ux_show_failure_feedback();
		}

		k_sleep(K_MSEC(BUTTON_REARM_SETTLE_MS));
		button_ux_set_interrupt_enabled(true);
		power_policy_set_interaction_awake(false);
		set_state(STATE_IDLE);
		button_ux_all_off();
	}

	return 0;
}
```

## src/button_ux.c
```c
#include "button_ux.h"

#include <errno.h>
#include <stddef.h>

#include <zephyr/device.h>
#include <zephyr/drivers/gpio.h>
#include <zephyr/logging/log.h>

LOG_MODULE_REGISTER(button_ux);

#define BUTTON_PIN    31
#define ORANGE_PIN    30
#define GREEN_PIN     29
#define RED_PIN       28

#define STARTUP_FLASH_COUNT      3
#define STARTUP_FLASH_ON_MS      150
#define STARTUP_FLASH_OFF_MS     150

/* Shared green/red "blink-blink then solid" terminal feedback timing;
 * reuses the previously validated quick-flash cadence. */
#define FEEDBACK_BLINK_COUNT     2
#define FEEDBACK_BLINK_ON_MS     40
#define FEEDBACK_BLINK_OFF_MS    40
#define FEEDBACK_SOLID_MS        5000

static const struct device *gpio0_dev = DEVICE_DT_GET(DT_NODELABEL(gpio0));
static struct gpio_callback button_cb;
static struct k_sem *press_wake_sem;
static volatile bool button_wake_pending;

static bool button_is_pressed(void)
{
	int raw = gpio_pin_get(gpio0_dev, BUTTON_PIN);

	/*
	 * Internal pull-up:
	 * released      = raw 1
	 * fully pressed = raw 0
	 */
	return raw == 0;
}

int button_ux_is_pressed(bool *pressed)
{
	int raw;

	if (pressed == NULL) {
		return -EINVAL;
	}

	raw = gpio_pin_get(gpio0_dev, BUTTON_PIN);
	if (raw < 0) {
		return raw;
	}

	*pressed = raw == 0;
	return 0;
}

static void button_pressed_cb(const struct device *dev, struct gpio_callback *cb,
			     uint32_t pins)
{
	ARG_UNUSED(dev);
	ARG_UNUSED(cb);
	ARG_UNUSED(pins);

	if (!button_is_pressed()) {
		return;
	}

	button_wake_pending = true;
	k_sem_give(press_wake_sem);
}

bool button_ux_take_press_pending(void)
{
	bool pending = button_wake_pending;

	button_wake_pending = false;
	return pending;
}

void button_ux_set_interrupt_enabled(bool enabled)
{
	gpio_pin_interrupt_configure(gpio0_dev, BUTTON_PIN,
				     enabled ? GPIO_INT_EDGE_FALLING : GPIO_INT_DISABLE);
}

static void indicator_on(int pin)
{
	gpio_pin_set(gpio0_dev, pin, 1);
}

static void indicator_off(int pin)
{
	gpio_pin_set(gpio0_dev, pin, 0);
}

static void indicator_flash(int pin, int count, int on_ms, int off_ms)
{
	for (int i = 0; i < count; i++) {
		indicator_on(pin);
		k_sleep(K_MSEC(on_ms));
		indicator_off(pin);
		k_sleep(K_MSEC(off_ms));
	}
}

void button_ux_all_off(void)
{
	indicator_off(ORANGE_PIN);
	indicator_off(GREEN_PIN);
	indicator_off(RED_PIN);
}

void button_ux_orange_on(void)
{
	indicator_on(ORANGE_PIN);
}

void button_ux_orange_off(void)
{
	indicator_off(ORANGE_PIN);
}

void button_ux_show_success_feedback(void)
{
	indicator_flash(GREEN_PIN, FEEDBACK_BLINK_COUNT, FEEDBACK_BLINK_ON_MS, FEEDBACK_BLINK_OFF_MS);
	indicator_on(GREEN_PIN);
	k_sleep(K_MSEC(FEEDBACK_SOLID_MS));
	indicator_off(GREEN_PIN);
}

void button_ux_show_failure_feedback(void)
{
	indicator_flash(RED_PIN, FEEDBACK_BLINK_COUNT, FEEDBACK_BLINK_ON_MS, FEEDBACK_BLINK_OFF_MS);
	indicator_on(RED_PIN);
	k_sleep(K_MSEC(FEEDBACK_SOLID_MS));
	indicator_off(RED_PIN);
}

void button_ux_startup_flash(void)
{
	indicator_flash(ORANGE_PIN, STARTUP_FLASH_COUNT, STARTUP_FLASH_ON_MS, STARTUP_FLASH_OFF_MS);
}

int button_ux_init(struct k_sem *wake_sem)
{
	int ret;

	press_wake_sem = wake_sem;

	if (!device_is_ready(gpio0_dev)) {
		LOG_ERR("GPIO0 device is not ready");
		return -ENODEV;
	}

	ret = gpio_pin_configure(gpio0_dev, BUTTON_PIN, GPIO_INPUT | GPIO_PULL_UP);
	if (ret < 0) {
		LOG_ERR("Failed to configure button GPIO P0.%d: %d", BUTTON_PIN, ret);
		return ret;
	}

	ret = gpio_pin_configure(gpio0_dev, ORANGE_PIN, GPIO_OUTPUT_INACTIVE);
	if (ret < 0) {
		LOG_ERR("Failed to configure orange indicator GPIO P0.%d: %d", ORANGE_PIN, ret);
		return ret;
	}

	ret = gpio_pin_configure(gpio0_dev, GREEN_PIN, GPIO_OUTPUT_INACTIVE);
	if (ret < 0) {
		LOG_ERR("Failed to configure green indicator GPIO P0.%d: %d", GREEN_PIN, ret);
		return ret;
	}

	ret = gpio_pin_configure(gpio0_dev, RED_PIN, GPIO_OUTPUT_INACTIVE);
	if (ret < 0) {
		LOG_ERR("Failed to configure red indicator GPIO P0.%d: %d", RED_PIN, ret);
		return ret;
	}

	gpio_init_callback(&button_cb, button_pressed_cb, BIT(BUTTON_PIN));
	ret = gpio_add_callback(gpio0_dev, &button_cb);
	if (ret < 0) {
		LOG_ERR("Failed to add button GPIO callback: %d", ret);
		return ret;
	}

	ret = gpio_pin_interrupt_configure(gpio0_dev, BUTTON_PIN, GPIO_INT_EDGE_FALLING);
	if (ret < 0) {
		LOG_ERR("Failed to configure button GPIO interrupt: %d", ret);
		return ret;
	}

	return 0;
}
```

## src/button_ux.h
```c
#ifndef BUTTON_UX_H
#define BUTTON_UX_H

#include <stdbool.h>

#include <zephyr/kernel.h>

/*
 * Owns the PV8 button GPIO (debounce-free hardware debounce via the
 * physical switch, edge interrupt only), the three indicator LEDs, and
 * their R/Y/G feedback patterns. Pure hardware mechanics: callers own all
 * sequencing/business logic (what to show when).
 *
 * Confirmed hardware mappings (Monarch Bay Pilot final architecture; see
 * docs/HARDWARE_ASSEMBLY_GUIDE.md and docs/HARDWARE_BOM.md):
 *   PV8 switch       -> Feather J1/5 -> nRF GPIO P0.31
 *   Orange (SENDING)          -> Feather J1/6 -> nRF GPIO P0.30
 *   Green  (REQUEST RECEIVED) -> Feather J1/7 -> nRF GPIO P0.29
 *   Red    (TRY AGAIN)        -> Feather J1/8 -> nRF GPIO P0.28
 */

/* Configures the button and all three indicator pins, arms the button
 * interrupt (edge-falling, enabled), and stores wake_sem for the ISR to
 * give on a validated press. Returns <0 on failure (caller should abort
 * boot, matching prior behavior).
 */
int button_ux_init(struct k_sem *wake_sem);

/* Reads the configured PV8 input; used at boot to select normal or explicit
 * debugger service mode.
 */
int button_ux_is_pressed(bool *pressed);

void button_ux_startup_flash(void);

/* Disabled while an accepted press is being handled, so switch bounce
 * cannot queue a second press mid-transaction; re-armed after terminal
 * feedback plus the settle delay.
 */
void button_ux_set_interrupt_enabled(bool enabled);

/* Atomically checks and clears the ISR-set press-pending flag. Callers
 * must only trust a wake on wake_sem as a genuine button press after this
 * returns true -- wake_sem is also given by the transaction scheduler for
 * an unrelated reason, and a stray wake at the loop boundary must not be
 * misread as a new press.
 */
bool button_ux_take_press_pending(void);

void button_ux_orange_on(void);
void button_ux_orange_off(void);
void button_ux_show_success_feedback(void);
void button_ux_show_failure_feedback(void);
void button_ux_all_off(void);

#endif /* BUTTON_UX_H */
```

## src/command_protocol.c
```c
#include "command_protocol.h"

#include <errno.h>
#include <stdio.h>
#include <string.h>

#include <zephyr/data/json.h>
#include <zephyr/sys/printk.h>
#include <zephyr/sys/util.h>

#include "device_identity.h"
#include "http_transport.h"

static char http_response_buffer[4096];

struct complete_command_json {
	const char *command_id;
	const char *device_id;
	const char *type;
	const char *request_id;
};

static const struct json_obj_descr complete_command_descr[] = {
	JSON_OBJ_DESCR_PRIM(struct complete_command_json, command_id, JSON_TOK_STRING),
	JSON_OBJ_DESCR_PRIM(struct complete_command_json, device_id, JSON_TOK_STRING),
	JSON_OBJ_DESCR_PRIM(struct complete_command_json, type, JSON_TOK_STRING),
	JSON_OBJ_DESCR_PRIM(struct complete_command_json, request_id, JSON_TOK_STRING),
};

struct command_poll_response_json {
	struct complete_command_json command;
};

static const struct json_obj_descr command_poll_response_descr[] = {
	JSON_OBJ_DESCR_OBJECT(struct command_poll_response_json, command,
			      complete_command_descr),
};

static bool copy_id(char *destination, size_t destination_len, const char *source)
{
	if (source == NULL || source[0] == '\0' || strlen(source) >= destination_len) {
		return false;
	}

	strcpy(destination, source);
	return true;
}

bool fairway_parse_complete_command(char *body, size_t body_len,
				    const char *active_device_id,
				    const char *active_request_id,
				    struct fairway_complete_command *command)
{
	struct command_poll_response_json response = {0};

	if (body == NULL || body_len == 0 || active_device_id == NULL ||
	    active_request_id == NULL || command == NULL ||
	    json_obj_parse(body, body_len, command_poll_response_descr,
			   ARRAY_SIZE(command_poll_response_descr), &response) < 0 ||
	    response.command.device_id == NULL ||
	    strcmp(response.command.device_id, active_device_id) != 0 ||
	    response.command.type == NULL || strcmp(response.command.type, "complete") != 0 ||
	    response.command.request_id == NULL ||
	    strcmp(response.command.request_id, active_request_id) != 0) {
		return false;
	}

	return copy_id(command->command_id, sizeof(command->command_id),
		       response.command.command_id) &&
	       copy_id(command->request_id, sizeof(command->request_id),
		       response.command.request_id);
}

int command_protocol_send_poll(const char *active_request_id,
			       struct fairway_complete_command *command,
			       int64_t attempt_deadline_ms)
{
	char body[256];
	char request[768];
	struct fairway_device_identity identity;
	int ret = fairway_device_identity_load(&identity);

	if (ret != 0) {
		return ret;
	}

	int body_len = snprintk(body, sizeof(body),
		"{\"device_id\":\"%s\",\"active_request_id\":\"%s\"}",
		identity.device_id, active_request_id);

	if (body_len < 0 || body_len >= sizeof(body)) {
		memset(&identity, 0, sizeof(identity));
		return -ENOMEM;
	}

	int request_len = snprintk(request, sizeof(request),
		"POST /api/v1/device-commands/poll HTTP/1.1\r\n"
		"Host: " FAIRWAY_HOST "\r\n"
		"Content-Type: application/json\r\n"
		"X-Fairway-Device-Key: %s\r\n"
		"Content-Length: %d\r\nConnection: close\r\n\r\n%s",
		identity.device_key, body_len, body);

	if (request_len < 0 || request_len >= sizeof(request)) {
		memset(&identity, 0, sizeof(identity));
		memset(body, 0, sizeof(body));
		return -ENOMEM;
	}

	command->command_id[0] = '\0';

	struct http_transport_response response = {
		.storage = http_response_buffer,
		.storage_capacity = sizeof(http_response_buffer),
	};
	ret = http_transport_send(request, request_len, attempt_deadline_ms, true, &response);
	memset(request, 0, sizeof(request));
	memset(body, 0, sizeof(body));

	if (ret != 0) {
		memset(http_response_buffer, 0, sizeof(http_response_buffer));
		memset(&identity, 0, sizeof(identity));
		return ret;
	}

	(void)fairway_parse_complete_command(response.body, response.body_len,
					     identity.device_id, active_request_id, command);
	memset(http_response_buffer, 0, sizeof(http_response_buffer));
	memset(&identity, 0, sizeof(identity));
	return 0;
}

int command_protocol_send_ack(const struct fairway_complete_command *command,
			      int64_t attempt_deadline_ms)
{
	char body[256];
	char request[768];
	struct fairway_device_identity identity;

	int ret = fairway_device_identity_load(&identity);

	if (ret != 0) {
		return ret;
	}

	int body_len = snprintk(body, sizeof(body),
		"{\"device_id\":\"%s\",\"request_id\":\"%s\"}",
		identity.device_id, command->request_id);

	if (body_len < 0 || body_len >= sizeof(body)) {
		memset(&identity, 0, sizeof(identity));
		return -ENOMEM;
	}

	int request_len = snprintk(request, sizeof(request),
		"POST /api/v1/device-commands/%s/ack HTTP/1.1\r\n"
		"Host: " FAIRWAY_HOST "\r\n"
		"Content-Type: application/json\r\n"
		"X-Fairway-Device-Key: %s\r\n"
		"Content-Length: %d\r\nConnection: close\r\n\r\n%s",
		command->command_id, identity.device_key, body_len, body);

	if (request_len < 0 || request_len >= sizeof(request)) {
		memset(&identity, 0, sizeof(identity));
		memset(body, 0, sizeof(body));
		return -ENOMEM;
	}

	struct http_transport_response response = {
		.storage = http_response_buffer,
		.storage_capacity = sizeof(http_response_buffer),
	};

	ret = http_transport_send(request, request_len, attempt_deadline_ms, true, &response);
	memset(request, 0, sizeof(request));
	memset(body, 0, sizeof(body));
	memset(&identity, 0, sizeof(identity));
	memset(http_response_buffer, 0, sizeof(http_response_buffer));
	return ret;
}
```

## src/command_protocol.h
```c
#ifndef COMMAND_PROTOCOL_H
#define COMMAND_PROTOCOL_H

#include <stdbool.h>
#include <stddef.h>
#include <stdint.h>

#include "golfer_acceptance.h"

#define FAIRWAY_COMMAND_ID_MAX 128

struct fairway_complete_command {
	char command_id[FAIRWAY_COMMAND_ID_MAX];
	char request_id[FAIRWAY_REQUEST_ID_MAX];
};

bool fairway_parse_complete_command(char *body, size_t body_len,
				    const char *active_device_id,
				    const char *active_request_id,
				    struct fairway_complete_command *command);

/* COMPLETE wire-protocol senders: build the request and parse the
 * response via the shared transport. Return value convention matches
 * http_transport_send().
 */
int command_protocol_send_poll(const char *active_request_id,
			       struct fairway_complete_command *command,
			       int64_t attempt_deadline_ms);
int command_protocol_send_ack(const struct fairway_complete_command *command,
			      int64_t attempt_deadline_ms);

#endif /* COMMAND_PROTOCOL_H */
```

## src/complete_poll.c
```c
#include "complete_poll.h"

#include <string.h>

static struct complete_poll_snapshot poll;
static struct k_spinlock poll_lock;
static struct k_sem *poll_wake_sem;

static void timer_expiry(struct k_timer *timer)
{
	ARG_UNUSED(timer);

	if (poll_wake_sem != NULL) {
		k_sem_give(poll_wake_sem);
	}
}

K_TIMER_DEFINE(poll_timer, timer_expiry, NULL);

static bool state_is_terminal(void)
{
	return poll.state == COMPLETE_POLL_INACTIVE ||
	       poll.state == COMPLETE_POLL_COMPLETE ||
	       poll.state == COMPLETE_POLL_EXPIRED;
}

static void expire_if_due(int64_t now_ms)
{
	if (!state_is_terminal() && now_ms >= poll.deadline_ms) {
		poll.state = COMPLETE_POLL_EXPIRED;
	}
}

static void advance_target_after(int64_t now_ms)
{
	do {
		poll.next_target_ms += COMPLETE_POLL_INTERVAL_MS;
	} while (poll.next_target_ms <= now_ms &&
		 poll.next_target_ms < poll.deadline_ms);
}

static void arm_timer(int64_t now_ms)
{
	int64_t wake_at_ms;

	if (state_is_terminal()) {
		k_timer_stop(&poll_timer);
		return;
	}

	switch (poll.state) {
	case COMPLETE_POLL_WAIT:
		wake_at_ms = poll.next_target_ms;
		break;
	case COMPLETE_ACK_WAIT:
		wake_at_ms = poll.next_action_ms;
		break;
	case COMPLETE_LTE_WAIT_POLL:
	case COMPLETE_LTE_WAIT_ACK:
		wake_at_ms = poll.next_target_ms;
		break;
	case COMPLETE_POLL_IN_FLIGHT:
	case COMPLETE_ACK_IN_FLIGHT:
		wake_at_ms = poll.deadline_ms;
		break;
	default:
		k_timer_stop(&poll_timer);
		return;
	}

	if (wake_at_ms > poll.deadline_ms) {
		wake_at_ms = poll.deadline_ms;
	}
	k_timer_start(&poll_timer, K_MSEC(MAX(wake_at_ms - now_ms, 0)), K_NO_WAIT);
}

static void fill_action(enum complete_poll_action_type type,
			struct complete_poll_action *action)
{
	*action = (struct complete_poll_action){
		.type = type,
		.generation = poll.generation,
		.deadline_ms = poll.deadline_ms,
		.command = poll.command,
	};
	strcpy(action->request_id, poll.request_id);
}

void complete_poll_init(struct k_sem *wake_sem)
{
	k_spinlock_key_t key = k_spin_lock(&poll_lock);

	k_timer_stop(&poll_timer);
	memset(&poll, 0, sizeof(poll));
	poll_wake_sem = wake_sem;
	k_spin_unlock(&poll_lock, key);
}

bool complete_poll_start(uint32_t generation, const char *request_id,
			 int64_t timeline_start_ms, int64_t deadline_ms)
{
	if (request_id == NULL || request_id[0] == '\0' ||
	    strlen(request_id) >= sizeof(poll.request_id) ||
	    timeline_start_ms >= deadline_ms) {
		return false;
	}

	k_spinlock_key_t key = k_spin_lock(&poll_lock);

	poll = (struct complete_poll_snapshot){
		.state = COMPLETE_POLL_WAIT,
		.generation = generation,
		.deadline_ms = deadline_ms,
		.next_target_ms = timeline_start_ms + COMPLETE_POLL_INTERVAL_MS,
	};
	strcpy(poll.request_id, request_id);
	arm_timer(timeline_start_ms);
	k_spin_unlock(&poll_lock, key);
	return true;
}

bool complete_poll_next_action(int64_t now_ms, bool lte_registered,
			       struct complete_poll_action *action)
{
	if (action == NULL) {
		return false;
	}

	k_spinlock_key_t key = k_spin_lock(&poll_lock);

	expire_if_due(now_ms);
	bool ready = false;

	if (poll.state == COMPLETE_LTE_WAIT_POLL ||
	    poll.state == COMPLETE_LTE_WAIT_ACK) {
		if (lte_registered) {
			enum complete_poll_action_type type =
				poll.state == COMPLETE_LTE_WAIT_POLL ?
				COMPLETE_ACTION_POLL : COMPLETE_ACTION_ACK;

			fill_action(type, action);
			poll.state = type == COMPLETE_ACTION_POLL ?
				COMPLETE_POLL_IN_FLIGHT : COMPLETE_ACK_IN_FLIGHT;
			if (now_ms >= poll.next_target_ms) {
				advance_target_after(now_ms);
			}
			ready = true;
		} else if (now_ms >= poll.next_target_ms) {
			advance_target_after(now_ms);
		}

		arm_timer(now_ms);
		k_spin_unlock(&poll_lock, key);
		return ready;
	}

	if (poll.state == COMPLETE_POLL_WAIT && now_ms >= poll.next_target_ms) {
		if (!lte_registered) {
			poll.state = COMPLETE_LTE_WAIT_POLL;
			advance_target_after(now_ms);
		} else {
			fill_action(COMPLETE_ACTION_POLL, action);
			poll.state = COMPLETE_POLL_IN_FLIGHT;
			advance_target_after(now_ms);
			ready = true;
		}
	} else if (poll.state == COMPLETE_ACK_WAIT && now_ms >= poll.next_action_ms) {
		if (!lte_registered) {
			poll.state = COMPLETE_LTE_WAIT_ACK;
			if (now_ms >= poll.next_target_ms) {
				advance_target_after(now_ms);
			}
		} else {
			fill_action(COMPLETE_ACTION_ACK, action);
			poll.state = COMPLETE_ACK_IN_FLIGHT;
			if (now_ms >= poll.next_target_ms) {
				advance_target_after(now_ms);
			}
			ready = true;
		}
	}

	arm_timer(now_ms);
	k_spin_unlock(&poll_lock, key);
	return ready;
}

void complete_poll_poll_finished(uint32_t generation, int64_t now_ms, int result,
				 const struct fairway_complete_command *command)
{
	k_spinlock_key_t key = k_spin_lock(&poll_lock);

	if (poll.generation != generation || poll.state != COMPLETE_POLL_IN_FLIGHT) {
		k_spin_unlock(&poll_lock, key);
		return;
	}

	expire_if_due(now_ms);
	if (poll.state == COMPLETE_POLL_EXPIRED) {
		arm_timer(now_ms);
		k_spin_unlock(&poll_lock, key);
		return;
	}

	bool correlated = result == 0 && command != NULL &&
			  command->command_id[0] != '\0' &&
			  strcmp(command->request_id, poll.request_id) == 0;

	if (correlated) {
		poll.command = *command;
		poll.next_action_ms = now_ms;
		poll.state = COMPLETE_ACK_WAIT;
	} else {
		poll.state = COMPLETE_POLL_WAIT;
	}
	arm_timer(now_ms);
	k_spin_unlock(&poll_lock, key);
}

bool complete_poll_ack_finished(uint32_t generation, int64_t now_ms, int result)
{
	k_spinlock_key_t key = k_spin_lock(&poll_lock);

	if (poll.generation != generation || poll.state != COMPLETE_ACK_IN_FLIGHT) {
		k_spin_unlock(&poll_lock, key);
		return false;
	}

	expire_if_due(now_ms);
	bool confirmed = poll.state != COMPLETE_POLL_EXPIRED && result == 0;

	if (confirmed) {
		poll.state = COMPLETE_POLL_COMPLETE;
	} else if (poll.state != COMPLETE_POLL_EXPIRED) {
		poll.next_action_ms = poll.next_target_ms;
		poll.state = COMPLETE_ACK_WAIT;
	}
	arm_timer(now_ms);
	k_spin_unlock(&poll_lock, key);
	return confirmed;
}

void complete_poll_signal(void)
{
	if (poll_wake_sem != NULL) {
		k_sem_give(poll_wake_sem);
	}
}

struct complete_poll_snapshot complete_poll_get_snapshot(int64_t now_ms)
{
	k_spinlock_key_t key = k_spin_lock(&poll_lock);

	expire_if_due(now_ms);
	struct complete_poll_snapshot snapshot = poll;

	arm_timer(now_ms);
	k_spin_unlock(&poll_lock, key);
	return snapshot;
}
```

## src/complete_poll.h
```c
#ifndef COMPLETE_POLL_H
#define COMPLETE_POLL_H

#include <stdbool.h>
#include <stdint.h>

#include <zephyr/kernel.h>

#include "command_protocol.h"

#define COMPLETE_POLL_INTERVAL_MS 15000

enum complete_poll_state {
	COMPLETE_POLL_INACTIVE = 0,
	COMPLETE_POLL_WAIT,
	COMPLETE_POLL_IN_FLIGHT,
	COMPLETE_ACK_WAIT,
	COMPLETE_ACK_IN_FLIGHT,
	COMPLETE_LTE_WAIT_POLL,
	COMPLETE_LTE_WAIT_ACK,
	COMPLETE_POLL_COMPLETE,
	COMPLETE_POLL_EXPIRED,
};

enum complete_poll_action_type {
	COMPLETE_ACTION_POLL = 0,
	COMPLETE_ACTION_ACK,
};

struct complete_poll_action {
	enum complete_poll_action_type type;
	uint32_t generation;
	int64_t deadline_ms;
	char request_id[FAIRWAY_REQUEST_ID_MAX];
	struct fairway_complete_command command;
};

struct complete_poll_snapshot {
	enum complete_poll_state state;
	uint32_t generation;
	int64_t deadline_ms;
	int64_t next_target_ms;
	int64_t next_action_ms;
	char request_id[FAIRWAY_REQUEST_ID_MAX];
	struct fairway_complete_command command;
};

void complete_poll_init(struct k_sem *wake_sem);
bool complete_poll_start(uint32_t generation, const char *request_id,
			 int64_t timeline_start_ms, int64_t deadline_ms);
bool complete_poll_next_action(int64_t now_ms, bool lte_registered,
			       struct complete_poll_action *action);
void complete_poll_poll_finished(uint32_t generation, int64_t now_ms, int result,
				 const struct fairway_complete_command *command);
bool complete_poll_ack_finished(uint32_t generation, int64_t now_ms, int result);
void complete_poll_signal(void);
struct complete_poll_snapshot complete_poll_get_snapshot(int64_t now_ms);

#endif /* COMPLETE_POLL_H */
```

## src/demand_window.c
```c
#include "demand_window.h"

#include <string.h>

#include <zephyr/kernel.h>

static struct demand_window_snapshot window;
static struct k_spinlock window_lock;

static void expire_if_due(int64_t now_ms)
{
	if (window.active && now_ms >= window.deadline_ms) {
		window.active = false;
	}
}

void demand_window_init(void)
{
	k_spinlock_key_t key = k_spin_lock(&window_lock);

	memset(&window, 0, sizeof(window));
	k_spin_unlock(&window_lock, key);
}

bool demand_window_start(uint32_t generation,
			 const struct golfer_acceptance *acceptance,
			 int64_t now_ms)
{
	if (acceptance == NULL || acceptance->request_id[0] == '\0' ||
	    strlen(acceptance->request_id) >= sizeof(window.request_id) ||
	    acceptance->golfer_demand_window_ms == 0 ||
	    acceptance->press_time_ms < 0 || acceptance->response_received_ms < 0 ||
	    (acceptance->duplicate && acceptance->demand_window_remaining_ms >
	     acceptance->golfer_demand_window_ms) ||
	    (!acceptance->duplicate && acceptance->demand_window_remaining_ms != 0)) {
		return false;
	}

	int64_t timeline_start_ms = acceptance->duplicate
		? acceptance->response_received_ms : acceptance->press_time_ms;
	uint32_t duration_ms = acceptance->duplicate
		? acceptance->demand_window_remaining_ms
		: acceptance->golfer_demand_window_ms;
	if (timeline_start_ms > INT64_MAX - duration_ms) {
		return false;
	}
	int64_t deadline_ms = timeline_start_ms + duration_ms;
	k_spinlock_key_t key = k_spin_lock(&window_lock);

	window = (struct demand_window_snapshot){
		.active = duration_ms > 0 && now_ms < deadline_ms,
		.generation = generation,
		.timeline_start_ms = timeline_start_ms,
		.deadline_ms = deadline_ms,
		.golfer_demand_window_ms = acceptance->golfer_demand_window_ms,
		.duplicate = acceptance->duplicate,
	};
	strcpy(window.request_id, acceptance->request_id);
	k_spin_unlock(&window_lock, key);
	return true;
}

bool demand_window_repeat_press(int64_t now_ms, uint32_t *repeat_press_count)
{
	k_spinlock_key_t key = k_spin_lock(&window_lock);

	expire_if_due(now_ms);
	bool active = window.active;

	if (active) {
		window.repeat_press_count++;
		if (repeat_press_count != NULL) {
			*repeat_press_count = window.repeat_press_count;
		}
	}
	k_spin_unlock(&window_lock, key);
	return active;
}

bool demand_window_clear_if_matches(uint32_t generation, const char *request_id,
				    int64_t now_ms)
{
	if (request_id == NULL) {
		return false;
	}

	k_spinlock_key_t key = k_spin_lock(&window_lock);

	expire_if_due(now_ms);
	bool matches = window.active && window.generation == generation &&
		       strcmp(window.request_id, request_id) == 0;

	if (matches) {
		window.active = false;
	}
	k_spin_unlock(&window_lock, key);
	return matches;
}

struct demand_window_snapshot demand_window_get_snapshot(int64_t now_ms)
{
	k_spinlock_key_t key = k_spin_lock(&window_lock);

	expire_if_due(now_ms);
	struct demand_window_snapshot snapshot = window;

	k_spin_unlock(&window_lock, key);
	return snapshot;
}
```

## src/demand_window.h
```c
#ifndef DEMAND_WINDOW_H
#define DEMAND_WINDOW_H

#include <stdbool.h>
#include <stddef.h>
#include <stdint.h>

#include "golfer_acceptance.h"

struct demand_window_snapshot {
	bool active;
	uint32_t generation;
	int64_t timeline_start_ms;
	int64_t deadline_ms;
	uint32_t golfer_demand_window_ms;
	bool duplicate;
	uint32_t repeat_press_count;
	char request_id[FAIRWAY_REQUEST_ID_MAX];
};

void demand_window_init(void);
bool demand_window_start(uint32_t generation,
			 const struct golfer_acceptance *acceptance,
			 int64_t now_ms);
bool demand_window_repeat_press(int64_t now_ms, uint32_t *repeat_press_count);
bool demand_window_clear_if_matches(uint32_t generation, const char *request_id,
				    int64_t now_ms);
struct demand_window_snapshot demand_window_get_snapshot(int64_t now_ms);

#endif /* DEMAND_WINDOW_H */
```

## src/device_identity.c
```c
#include "device_identity.h"

#include <errno.h>
#include <stdbool.h>
#include <string.h>

#include <psa/protected_storage.h>
#include <psa/storage_common.h>

#define FAIRWAY_DEVICE_ID_UID       ((psa_storage_uid_t)0x46520001)
#define FAIRWAY_DEVICE_KEY_UID      ((psa_storage_uid_t)0x46520002)

static bool valid_device_id(const char *device_id)
{
	if (device_id == NULL || strlen(device_id) != FAIRWAY_DEVICE_ID_MAX - 1 ||
	    memcmp(device_id, "FRB-", 4) != 0) {
		return false;
	}

	for (size_t i = 4; i < FAIRWAY_DEVICE_ID_MAX - 1; i++) {
		if (device_id[i] < '0' || device_id[i] > '9') {
			return false;
		}
	}

	return true;
}

static bool valid_device_key(const char *device_key)
{
	if (device_key == NULL || strlen(device_key) != FAIRWAY_DEVICE_KEY_MAX - 1) {
		return false;
	}

	for (size_t i = 0; i < FAIRWAY_DEVICE_KEY_MAX - 1; i++) {
		char c = device_key[i];

		if (!((c >= 'A' && c <= 'Z') || (c >= 'a' && c <= 'z') ||
		      (c >= '0' && c <= '9') || c == '_' || c == '-')) {
			return false;
		}
	}

	return strchr("AEIMQUYcgkosw048", device_key[FAIRWAY_DEVICE_KEY_MAX - 2]) != NULL;
}

static int read_value(psa_storage_uid_t uid, char *value, size_t capacity)
{
	size_t length = 0;
	psa_status_t status = psa_ps_get(uid, 0, capacity, value, &length);

	if (status != PSA_SUCCESS) {
		return status == PSA_ERROR_DOES_NOT_EXIST ? -ENOENT : -EIO;
	}
	if (length == 0 || length > capacity || value[length - 1] != '\0') {
		memset(value, 0, capacity);
		return -EBADMSG;
	}

	return 0;
}

static int read_device_id(char *device_id)
{
	int ret = read_value(FAIRWAY_DEVICE_ID_UID, device_id, FAIRWAY_DEVICE_ID_MAX);

	if (ret == 0 && !valid_device_id(device_id)) {
		memset(device_id, 0, FAIRWAY_DEVICE_ID_MAX);
		return -EBADMSG;
	}

	return ret;
}

static int read_device_key(char *device_key)
{
	int ret = read_value(FAIRWAY_DEVICE_KEY_UID, device_key, FAIRWAY_DEVICE_KEY_MAX);

	if (ret == 0 && !valid_device_key(device_key)) {
		memset(device_key, 0, FAIRWAY_DEVICE_KEY_MAX);
		return -EBADMSG;
	}

	return ret;
}

int fairway_device_identity_load(struct fairway_device_identity *identity)
{
	if (identity == NULL) {
		return -EINVAL;
	}

	memset(identity, 0, sizeof(*identity));
	int ret = read_device_id(identity->device_id);

	if (ret == 0) {
		ret = read_device_key(identity->device_key);
	}
	if (ret != 0) {
		memset(identity, 0, sizeof(*identity));
	}

	return ret;
}

int fairway_device_identity_provision(const char *device_id, const char *device_key)
{
	char stored_id[FAIRWAY_DEVICE_ID_MAX] = {0};
	char stored_key[FAIRWAY_DEVICE_KEY_MAX] = {0};
	int ret;

	if (!valid_device_id(device_id) || !valid_device_key(device_key)) {
		return -EINVAL;
	}

	ret = read_device_id(stored_id);
	if (ret == -ENOENT) {
		psa_status_t status = psa_ps_set(FAIRWAY_DEVICE_ID_UID, strlen(device_id) + 1,
						 device_id, PSA_STORAGE_FLAG_WRITE_ONCE);

		if (status != PSA_SUCCESS) {
			return -EIO;
		}
	} else if (ret != 0) {
		return ret;
	} else if (strcmp(stored_id, device_id) != 0) {
		return -EEXIST;
	}

	ret = read_device_key(stored_key);
	if (ret == 0) {
		return strcmp(stored_key, device_key) == 0 ? -EALREADY : -EEXIST;
	}
	if (ret != -ENOENT) {
		return ret;
	}

	return psa_ps_set(FAIRWAY_DEVICE_KEY_UID, strlen(device_key) + 1, device_key, 0) ==
		       PSA_SUCCESS
		       ? 0
		       : -EIO;
}

int fairway_device_identity_replace_key(const char *device_id, const char *device_key)
{
	char stored_id[FAIRWAY_DEVICE_ID_MAX] = {0};

	if (!valid_device_id(device_id) || !valid_device_key(device_key)) {
		return -EINVAL;
	}

	int ret = read_device_id(stored_id);

	if (ret != 0) {
		return ret;
	}
	if (strcmp(stored_id, device_id) != 0) {
		return -EACCES;
	}

	return psa_ps_set(FAIRWAY_DEVICE_KEY_UID, strlen(device_key) + 1, device_key, 0) ==
		       PSA_SUCCESS
		       ? 0
		       : -EIO;
}
```

## src/device_identity.h
```c
#ifndef FAIRWAY_DEVICE_IDENTITY_H
#define FAIRWAY_DEVICE_IDENTITY_H

#include <stddef.h>

#define FAIRWAY_DEVICE_ID_MAX 9
#define FAIRWAY_DEVICE_KEY_MAX 44

struct fairway_device_identity {
	char device_id[FAIRWAY_DEVICE_ID_MAX];
	char device_key[FAIRWAY_DEVICE_KEY_MAX];
};

int fairway_device_identity_load(struct fairway_device_identity *identity);
int fairway_device_identity_provision(const char *device_id, const char *device_key);
int fairway_device_identity_replace_key(const char *device_id, const char *device_key);

#endif
```

## src/golfer_acceptance.h
```c
#ifndef GOLFER_ACCEPTANCE_H
#define GOLFER_ACCEPTANCE_H

#include <stdbool.h>
#include <stdint.h>

#define FAIRWAY_REQUEST_ID_MAX 96

struct golfer_acceptance {
	char request_id[FAIRWAY_REQUEST_ID_MAX];
	uint32_t golfer_demand_window_ms;
	uint32_t demand_window_remaining_ms;
	bool duplicate;
	int64_t press_time_ms;
	int64_t response_received_ms;
};

#endif /* GOLFER_ACCEPTANCE_H */
```
