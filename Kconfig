## Kconfig
```kconfig
#
# Copyright (c) 2020 Circuit Dojo
#
# SPDX-License-Identifier: Apache-2.0
#

menu "Fairway Refresh"

rsource "drivers/Kconfig"
rsource "lib/Kconfig"

endmenu
```

## samples/fairway_power_sandbox/tests/complete_poll/testcase.yaml
```yaml
tests:
  fairway.complete_poll:
    platform_allow:
      - native_sim
    integration_platforms:
      - native_sim
    tags:
      - fairway
      - complete_poll
```

## tests/ota_update/testcase.yaml
```yaml
tests:
  fairway.ota.update_policy:
    harness: ztest
    platform_allow:
      - native_sim
    tags:
      - ota
```
